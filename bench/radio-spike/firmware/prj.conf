## CMakeLists.txt
```
# Radio bench spike firmware for the nRF52840 Dongle (PCA10059).
cmake_minimum_required(VERSION 3.20.0)
find_package(Zephyr REQUIRED HINTS $ENV{ZEPHYR_BASE})
project(kms_radio_bench)

target_sources(app PRIVATE
  src/main.c
  src/cmd.c
  src/rec.c
  src/stamp.c
  src/ident.c
  src/wdt.c
  src/link.c
  src/radio.c
  src/traffic.c
  src/cand_b.c
  src/cand_a.c
  src/scan.c
  src/jam.c
)

# FW_VERSION: `git describe` of HEAD, "-dirty" when the firmware tree has
# local changes. Regenerated on every build.
set(FW_VERSION_DIR ${CMAKE_CURRENT_BINARY_DIR}/fw_version)
add_custom_target(fw_version
  COMMAND ${CMAKE_COMMAND} -DSRC=${CMAKE_CURRENT_SOURCE_DIR}
          -DOUT=${FW_VERSION_DIR}/fw_version.h
          -P ${CMAKE_CURRENT_SOURCE_DIR}/fw_version.cmake
  BYPRODUCTS ${FW_VERSION_DIR}/fw_version.h)
add_dependencies(app fw_version)
target_include_directories(app PRIVATE ${FW_VERSION_DIR})
```

## prj.conf
```kconfig
# Our own USB device (VID:PID, serial from DEVICEADDR) instead of the
# board's CDC console backend.
CONFIG_CDC_ACM_SERIAL_INITIALIZE_AT_BOOT=n
CONFIG_USB_DEVICE_STACK_NEXT=y
CONFIG_SERIAL=y
CONFIG_UART_INTERRUPT_DRIVEN=y
CONFIG_UART_LINE_CTRL=y
CONFIG_CONSOLE=n
CONFIG_UART_CONSOLE=n
CONFIG_LOG=n

CONFIG_CLOCK_CONTROL=y
CONFIG_NRFX_GPPI=y
CONFIG_ENTROPY_GENERATOR=y
CONFIG_RING_BUFFER=y
CONFIG_MAIN_STACK_SIZE=4096
CONFIG_RESET_ON_FATAL_ERROR=y

# Enhanced ShockBurst. The firmware holds the HFXO itself.
CONFIG_ESB=y

# A: every linked pipe, phantoms included, holds an ACK payload in
# ESB, and the active pipe up to 4 reports.
CONFIG_ESB_TX_FIFO_SIZE=32

# ESB's radio interrupt must run within the TX ramp-up (40 µs with fast
# ramp-up) after a packet: the PRX turns to TX in hardware, and if the
# interrupt is late the radio sends the received packet back as the ACK
# (seen as MIC failures in candidate A). At the default 1 it shares the
# priority of USB and the system timer and can't preempt them.
CONFIG_ESB_RADIO_IRQ_PRIORITY=0
```

## src/main.c
```c
/*
 * Radio bench spike firmware: see
 * docs/superpowers/plans/2026-11-07-radio-bench-spike.md.
 */
#include <zephyr/drivers/clock_control.h>
#include <zephyr/drivers/clock_control/nrf_clock_control.h>
#include <zephyr/kernel.h>
#include <zephyr/random/random.h>

#include "cmd.h"
#include "ident.h"
#include "radio.h"
#include "rec.h"
#include "stamp.h"
#include "wdt.h"

#define STATS_PERIOD_MS 1000

/* Hold the HFXO for good: timestamps and the radio need the crystal. */
static int hfxo_hold(void)
{
	static struct onoff_client cli;
	struct onoff_manager *mgr = z_nrf_clock_control_get_onoff(CLOCK_CONTROL_NRF_SUBSYS_HF);
	int err, res;

	if (mgr == NULL) {
		return -ENODEV;
	}
	sys_notify_init_spinwait(&cli.notify);
	err = onoff_request(mgr, &cli);
	if (err < 0) {
		return err;
	}
	do {
		err = sys_notify_fetch_result(&cli.notify, &res);
		if (err == -EAGAIN) {
			k_yield();
		}
	} while (err == -EAGAIN);
	return err ?: res;
}

static void usb_msg(struct usbd_context *const ctx, const struct usbd_msg *msg)
{
	switch (msg->type) {
	case USBD_MSG_VBUS_READY:
		if (usbd_can_detect_vbus(ctx)) {
			(void)usbd_enable(ctx);
		}
		break;
	case USBD_MSG_VBUS_REMOVED:
		if (usbd_can_detect_vbus(ctx)) {
			(void)usbd_disable(ctx);
		}
		break;
	case USBD_MSG_CDC_ACM_CONTROL_LINE_STATE:
	case USBD_MSG_RESET:
	case USBD_MSG_SUSPEND:
	case USBD_MSG_RESUME:
		rec_dtr_update();
		break;
	default:
		break;
	}
}

int main(void)
{
	char line[CMD_LINE_MAX];
	int err_clk, err_stamp, err_rec, err_usb;
	int64_t next_stats;

	wdt_start();
	err_clk = hfxo_hold();
	err_stamp = stamp_init();
	err_rec = rec_init();
	cmd_init(sys_rand32_get());
	cmd_boot_record();
	err_usb = ident_usb_init(usb_msg);
	radio_init();
	cmd_resume();
	if (err_clk || err_stamp || err_rec || err_usb) {
		rec_text("error init clk=%d stamp=%d rec=%d usb=%d", err_clk,
			 err_stamp, err_rec, err_usb);
	}

	next_stats = k_uptime_get() + STATS_PERIOD_MS;
	for (;;) {
		if (cmd_feed_watchdog()) {
			wdt_feed();
		}
		if (rec_get_line(line, K_MSEC(100))) {
			cmd_handle(line);
		}
		int64_t now = k_uptime_get();

		if (now >= next_stats) {
			next_stats = now + STATS_PERIOD_MS;
			/* Only while the port is open: see the plan, Task 3. */
			if (rec_dtr()) {
				rec_stats();
			}
		}
	}
	return 0;
}
```

## src/cand_a.c
```c
/*
 * Candidate A: polling, Gazell-style. The bridge is PRX on all pipes and
 * answers polls with ACK payloads; receivers are PTX and poll it, the
 * active one every 500 µs, idle ones every 100 ms.
 *
 * ESB keeps one ACK-payload queue per pipe and drops the payload at the
 * front only when a new packet (new PID) arrives on that pipe, reporting
 * TX_SUCCESS and the new packet's RX in the same interrupt.
 */
#include <string.h>
#include <zephyr/random/random.h>

#include "cmd.h"
#include "radio.h"
#include "rec.h"
#include "stamp.h"
#include "traffic.h"

#define MAX_IN_ESB 4        /* REPORTs per pipe handed to ESB ahead of polls */
#define PENDING_POLL_US 5000 /* until the session's first payload verifies */
#define BUSY_WAIT_US 20000

/* Bridge ------------------------------------------------------------- */

static struct {
	uint8_t in_esb[NUM_PIPES];      /* payloads ESB holds for each pipe */
	bool ack_had[NUM_PIPES];        /* the last ACK on the pipe carried one */
	bool flag_sent[NUM_PIPES];      /* active flag last told to each pipe */
	int64_t last_report_us[NUM_PIPES];
} ab;

static void bridge_load(uint8_t pipe, uint8_t kind, uint8_t flags, uint32_t id,
			const uint8_t *data, uint8_t dlen)
{
	uint8_t out[RADIO_MAX_PAYLOAD];
	struct peer *pe = &peers[pipe];
	int n = session_seal(&pe->sk, &pe->tx_counter, LINK_DIR_TO_RECEIVER, kind, flags, id,
			     data, dlen, out);

	if (n > 0 && radio_ack_payload(pipe, out, n) == 0) {
		ab.in_esb[pipe]++;
		ab.flag_sent[pipe] = flags & PKT_FLAG_ACTIVE;
		if (kind == PKT_REPORT) {
			ab.last_report_us[pipe] = radio_now_us();
		}
	} else if (kind == PKT_REPORT) {
		atomic_inc(&counters.queue_dropped); /* ESB's queue was full */
	}
}

static void bridge_status(uint8_t pipe)
{
	uint8_t data[2] = {0};

	bridge_load(pipe, PKT_STATUS, pipe == active_pipe ? PKT_FLAG_ACTIVE : 0, pkt_new_id(),
		    data, 2);
}

/* Give ESB what each pipe needs; called after every event. */
static void bridge_fill(void)
{
	int64_t now = radio_now_us();
	struct report rep;
	uint8_t data[11];

	for (uint8_t p = 1; p < NUM_PIPES; p++) {
		struct peer *pe = &peers[p];
		bool pending = !pe->used && pe->hold_until_us > now;

		if (!pe->used && !pending) {
			continue;
		}
		if (p == active_pipe && pe->used) {
			while (ab.in_esb[p] < MAX_IN_ESB && traffic_next(p, &rep)) {
				/* "more pending": more queued behind it right now. */
				uint8_t flags = PKT_FLAG_ACTIVE |
						(traffic_count(p) ? PKT_FLAG_MORE : 0);

				report_data(&rep, data);
				bridge_load(p, PKT_REPORT, flags, rep.id, data, 11);
			}
			/* STATUS only when the flag changed or as the refresh, so a
			 * report never waits behind a STATUS sealed before it. */
			if (ab.in_esb[p] == 0 &&
			    (!ab.flag_sent[p] ||
			     now - ab.last_report_us[p] >= params.refresh_ms * 1000LL)) {
				memset(data, 0, sizeof(data));
				data[0] = REPORT_REFRESH;
				bridge_load(p, PKT_REPORT, PKT_FLAG_ACTIVE, pkt_new_id(), data, 11);
			}
		} else if (ab.in_esb[p] == 0) {
			bridge_status(p); /* idle or pending: a STATUS for every poll */
		}
	}
}

static void bridge_rx(const struct radio_evt *e)
{
	struct pkt_body b;

	if (e->pipe == 0) {
		rec_rxpkt(e, stamp_now(), 0, PKT_HELLO);
		int p = disco_bridge_hello(e);

		if (p > 0) {
			ab.in_esb[p] = 0;
			ab.ack_had[p] = false;
			ab.flag_sent[p] = false;
		}
		(void)disco_bridge_offer();
		return;
	}
	struct peer *pe = &peers[e->pipe];

	/* Mirror ESB (prepare_ack_pdu_dpl): on a new packet it drops the
	 * payload the previous ACK carried, then the ACK carries the next one,
	 * if any. ESB reports only new packets, valid or not. A payload loaded
	 * between ESB building an ACK and this event makes the count err low
	 * for one poll, never high, and it corrects itself. */
	if (ab.ack_had[e->pipe] && ab.in_esb[e->pipe]) {
		ab.in_esb[e->pipe]--;
	}
	ab.ack_had[e->pipe] = ab.in_esb[e->pipe] > 0;

	if (!pe->used && pe->hold_until_us == 0) {
		return;
	}
	int n = link_open(&pe->sk, LINK_DIR_TO_BRIDGE, &pe->rp, e->data, e->len, (uint8_t *)&b);

	if (n == -EALREADY) {
		atomic_inc(&counters.replay_reject);
		return;
	}
	if (n < 0) {
		atomic_inc(&counters.mic_fail);
		return;
	}
	pe->last_valid_us = radio_now_us();
	rec_rxpkt(e, stamp_now(), b.id, b.kind);
	if (!pe->established) {
		disco_bridge_established(e->pipe);
	}
}

static void bridge_event(const struct radio_evt *e)
{
	switch (e->type) {
	case RADIO_EVT_RX:
		bridge_rx(e);
		break;
	default:
		break;
	}
}

static uint32_t bridge_tick(void)
{
	int64_t now = radio_now_us(), next = INT64_MAX;

	for (uint8_t p = 1; p < NUM_PIPES; p++) {
		struct peer *pe = &peers[p];

		if (!pe->used && pe->hold_until_us && now >= pe->hold_until_us) {
			peer_free(p, false);
		} else if (pe->used && !pe->phantom &&
			   now - pe->last_valid_us > params.loss_ms * 1000LL) {
			peer_free(p, true);
		}
		if (pe->hold_until_us) {
			next = MIN(next, pe->hold_until_us);
		}
		if (pe->used && !pe->phantom) {
			next = MIN(next, pe->last_valid_us + params.loss_ms * 1000LL + 1);
		}
	}
	bridge_fill();
	if (active_pipe && peers[active_pipe].used) {
		next = MIN(next, ab.last_report_us[active_pipe] + params.refresh_ms * 1000LL);
	}
	return next == INT64_MAX ? UINT32_MAX : (uint32_t)CLAMP(next - now, 0, 1000000);
}

static void bridge_active(uint8_t pipe)
{
	if (pipe && (pipe >= NUM_PIPES || !peers[pipe].used)) {
		rec_text("error active: pipe %u not linked", pipe);
		return;
	}
	if (active_pipe) {
		rec_link(LINK_INACTIVE, active_pipe, peers[active_pipe].addr);
	}
	active_pipe = pipe;
	if (pipe) {
		ab.flag_sent[pipe] = false; /* tell it with its next payload */
		rec_link(LINK_ACTIVE, pipe, peers[pipe].addr);
	}
	rec_text("ok active %u", pipe);
}

static void bridge_phantom(uint8_t n)
{
	for (uint8_t p = NUM_PIPES - 1; p >= 1 && n; p--) {
		struct peer *pe = &peers[p];

		if (!pe->used && !pe->hold_until_us) {
			memset(pe, 0, sizeof(*pe));
			pe->used = pe->phantom = pe->established = true;
			sys_rand_get(pe->sk.bytes, sizeof(pe->sk.bytes));
			ab.in_esb[p] = 0;
			ab.ack_had[p] = false;
			rec_link(LINK_ESTABLISHED, p, pe->addr);
			n--;
		}
	}
	rec_text("ok phantom%s", n ? " (no free pipe)" : "");
}

/* Receiver ----------------------------------------------------------- */

enum { UNLINKED, PENDING, LINKED };

static struct {
	uint8_t st;
	bool busy, active, more;
	uint32_t tx_id;
	uint8_t tx_pipe, tx_kind, tx_len;
	int64_t next_tx_us, pending_until_us, last_valid_us;
} ar;

static void rx_unlink(bool lost)
{
	if (lost) {
		rec_link(LINK_LOST, self.pipe, NULL);
	}
	link_key_destroy(&self.sk);
	memset(&ar, 0, sizeof(ar));
}

static void rx_payload(const struct radio_evt *e)
{
	struct pkt_body b;
	int n = link_open(&self.sk, LINK_DIR_TO_RECEIVER, &self.rp, e->data, e->len, (uint8_t *)&b);

	if (n == -EALREADY) {
		atomic_inc(&counters.replay_reject);
		return;
	}
	if (n < 0) {
		atomic_inc(&counters.mic_fail);
		return;
	}
	rec_rxpkt(e, stamp_now(), b.id, b.kind);
	ar.last_valid_us = radio_now_us();
	if (ar.st == PENDING) {
		ar.st = LINKED;
		rec_link(LINK_ESTABLISHED, self.pipe, NULL);
	}
	bool act = b.flags & PKT_FLAG_ACTIVE;

	if (act != ar.active) {
		ar.active = act;
		rec_link(act ? LINK_ACTIVE : LINK_INACTIVE, self.pipe, NULL);
	}
	ar.more = b.flags & PKT_FLAG_MORE;
}

static void receiver_event(const struct radio_evt *e)
{
	struct radio_evt ack;

	if ((e->type != RADIO_EVT_TX_OK && e->type != RADIO_EVT_TX_FAIL) || !ar.busy) {
		return;
	}
	bool ok = e->type == RADIO_EVT_TX_OK;
	bool has_ack = ok && radio_take_ack(ar.tx_pipe, &ack);

	rec_txdone(e, ar.tx_id, ar.tx_pipe, ar.tx_kind, ok, ar.tx_len, has_ack ? ack.len : 0);
	ar.busy = false;
	ar.more = false;
	if (!has_ack) {
		return;
	}
	if (ar.st == UNLINKED) {
		if (disco_receiver_welcome(&ack) > 0) {
			ar.st = PENDING;
			ar.pending_until_us = radio_now_us() + 2 * params.hold_ms * 1000LL;
			ar.next_tx_us = 0; /* first poll at once */
		}
	} else {
		rx_payload(&ack);
	}
}

static void send_poll(void)
{
	uint8_t out[RADIO_MAX_PAYLOAD], data[2] = {1 /* USB configured */, 0};

	ar.tx_id = pkt_new_id();
	ar.tx_pipe = self.pipe;
	ar.tx_kind = PKT_POLL;
	ar.tx_len = session_seal(&self.sk, &self.tx_counter, LINK_DIR_TO_BRIDGE, PKT_POLL,
				 ar.active ? PKT_FLAG_ACTIVE : 0, ar.tx_id, data, 2, out);
	if (radio_send(self.pipe, out, ar.tx_len, params.retries_poll) == 0) {
		ar.busy = true;
	}
}

static uint32_t receiver_tick(void)
{
	int64_t now = radio_now_us();
	uint8_t out[RADIO_MAX_PAYLOAD];

	if (ar.st == PENDING && now >= ar.pending_until_us) {
		rx_unlink(false);
	} else if (ar.st == LINKED && now - ar.last_valid_us > params.loss_ms * 1000LL) {
		rx_unlink(true);
	}
	if (ar.busy) {
		return BUSY_WAIT_US;
	}
	if (ar.st == UNLINKED) {
		if (now >= ar.next_tx_us) {
			ar.tx_id = pkt_new_id();
			ar.tx_pipe = 0;
			ar.tx_kind = PKT_HELLO;
			ar.tx_len = disco_receiver_hello(out);
			if (radio_send(0, out, ar.tx_len, params.retries_hello) == 0) {
				ar.busy = true;
			}
			ar.next_tx_us = now + (params.hello_ms +
					       sys_rand32_get() % (params.hello_jitter_ms + 1)) *
						      1000LL;
		}
	} else if (ar.more || now >= ar.next_tx_us) {
		int64_t period = ar.st == PENDING ? PENDING_POLL_US
				 : ar.active      ? params.poll_active_us
						  : params.poll_idle_ms * 1000LL;

		/* Polls keep their rhythm: the next one is due a period after
		 * this one started, not after it finished. */
		ar.next_tx_us = MAX(ar.next_tx_us + period, now);
		send_poll();
	}
	return ar.busy ? BUSY_WAIT_US : (uint32_t)CLAMP(ar.next_tx_us - now, 0, 1000000);
}

/* Both sides ----------------------------------------------------------- */

static void start(void)
{
	memset(&ab, 0, sizeof(ab));
	memset(&ar, 0, sizeof(ar));
	if (g_role == 1) {
		radio_mode(RADIO_PRX, 0xFF);
		(void)disco_bridge_offer();
		radio_listen();
	} else {
		radio_mode(RADIO_PTX, 0xFF);
	}
}

static void stop(void)
{
	radio_mode(RADIO_OFF, 0);
}

static void event(const struct radio_evt *e)
{
	if (g_role == 1) {
		bridge_event(e);
	} else {
		receiver_event(e);
	}
}

static uint32_t tick(void)
{
	return g_role == 1 ? bridge_tick() : receiver_tick();
}

const struct cand cand_a = {
	.start = start, .stop = stop, .event = event, .tick = tick,
	.active = bridge_active, .phantom = bridge_phantom,
};
```

## src/cand_b.c
```c
/*
 * Candidate B: the bridge transmits on demand (PTX); receivers listen (PRX)
 * on their own pipe. With nothing to send, the bridge listens on pipe 0
 * for HELLOs with a WELCOME preloaded. One packet at a time goes to ESB:
 * the active receiver's reports, then its refresh, then pings.
 */
#include <string.h>
#include <zephyr/random/random.h>

#include "cmd.h"
#include "radio.h"
#include "rec.h"
#include "stamp.h"
#include "traffic.h"

#define BUSY_WAIT_US 20000

/* Bridge ------------------------------------------------------------- */

static struct {
	bool busy, prx;
	uint32_t id;
	uint8_t pipe, kind, len;
	int64_t last_active_tx_us;
} br;

static void bridge_listen(void)
{
	if (br.prx) {
		return;
	}
	radio_mode(RADIO_PRX, BIT(0));
	(void)disco_bridge_offer();
	radio_listen();
	br.prx = true;
}

static bool bridge_send(uint8_t pipe, uint8_t kind, uint32_t id, const uint8_t *data, uint8_t dlen,
			uint8_t retries)
{
	uint8_t out[RADIO_MAX_PAYLOAD];
	struct peer *pe = &peers[pipe];

	if (br.prx) {
		radio_mode(RADIO_PTX, 0xFF);
		br.prx = false;
	}
	int n = session_seal(&pe->sk, &pe->tx_counter, LINK_DIR_TO_RECEIVER, kind,
			     pipe == active_pipe ? PKT_FLAG_ACTIVE : 0, id, data, dlen, out);

	if (n < 0 || radio_send(pipe, out, n, retries) != 0) {
		return false;
	}
	br.busy = true;
	br.id = id;
	br.pipe = pipe;
	br.kind = kind;
	br.len = n;
	if (pipe == active_pipe) {
		br.last_active_tx_us = radio_now_us();
	}
	return true;
}

static void bridge_status(const struct radio_evt *e)
{
	struct peer *pe = &peers[e->pipe];
	struct pkt_body b;

	if (e->pipe == 0 || (!pe->used && pe->hold_until_us == 0)) {
		return;
	}
	int n = link_open(&pe->sk, LINK_DIR_TO_BRIDGE, &pe->rp, e->data, e->len, (uint8_t *)&b);

	if (n == -EALREADY) {
		atomic_inc(&counters.replay_reject);
		return;
	}
	if (n < 0) {
		atomic_inc(&counters.mic_fail);
		return;
	}
	pe->last_valid_us = radio_now_us();
	rec_rxpkt(e, stamp_now(), b.id, b.kind);
	if (!pe->established) {
		disco_bridge_established(e->pipe);
	}
}

static void bridge_event(const struct radio_evt *e)
{
	struct radio_evt ack;

	switch (e->type) {
	case RADIO_EVT_TX_OK:
	case RADIO_EVT_TX_FAIL: {
		if (!br.busy) {
			return;
		}
		bool ok = e->type == RADIO_EVT_TX_OK;
		bool has_ack = ok && radio_take_ack(br.pipe, &ack);

		rec_txdone(e, br.id, br.pipe, br.kind, ok, br.len, has_ack ? ack.len : 0);
		br.busy = false;
		if (has_ack) {
			bridge_status(&ack);
		}
		break;
	}
	case RADIO_EVT_RX:
		if (br.prx && e->pipe == 0) {
			rec_rxpkt(e, stamp_now(), 0, PKT_HELLO);
			(void)disco_bridge_hello(e);
			/* ESB queues it behind the offer the HELLO just got. */
			(void)disco_bridge_offer();
		}
		break;
	default:
		break;
	}
}

static uint32_t bridge_tick(void)
{
	int64_t now = radio_now_us(), next = INT64_MAX;
	struct report rep;
	uint8_t data[11] = {0};

	for (uint8_t p = 1; p < NUM_PIPES; p++) {
		struct peer *pe = &peers[p];

		if (!pe->used && pe->hold_until_us && now >= pe->hold_until_us) {
			peer_free(p, false); /* offer taken, no session: free again */
		} else if (pe->used && !pe->phantom &&
			   now - pe->last_valid_us > params.loss_ms * 1000LL) {
			peer_free(p, true);
		}
	}

	if (!br.busy) {
		bool live = active_pipe && peers[active_pipe].used;

		if (live && traffic_next(active_pipe, &rep)) {
			report_data(&rep, data);
			bridge_send(active_pipe, PKT_REPORT, rep.id, data, 11, params.retries_report);
		} else if (live && now - br.last_active_tx_us >= params.refresh_ms * 1000LL) {
			data[0] = REPORT_REFRESH;
			bridge_send(active_pipe, PKT_REPORT, pkt_new_id(), data, 11,
				    params.retries_report);
		} else {
			for (uint8_t p = 1; p < NUM_PIPES; p++) {
				struct peer *pe = &peers[p];
				bool pending = !pe->used && pe->hold_until_us > now;

				if ((pe->used || pending) && p != active_pipe &&
				    now >= pe->next_ping_us) {
					pe->next_ping_us = now + params.ping_ms * 1000LL;
					bridge_send(p, PKT_PING, pkt_new_id(), NULL, 0,
						    params.retries_ping);
					break;
				}
			}
		}
		if (!br.busy) {
			bridge_listen();
		}
	}
	if (br.busy) {
		return BUSY_WAIT_US;
	}

	if (active_pipe && peers[active_pipe].used) {
		next = MIN(next, br.last_active_tx_us + params.refresh_ms * 1000LL);
	}
	for (uint8_t p = 1; p < NUM_PIPES; p++) {
		struct peer *pe = &peers[p];

		if (pe->used || pe->hold_until_us) {
			if (p != active_pipe) {
				next = MIN(next, pe->next_ping_us);
			}
			if (pe->hold_until_us) {
				next = MIN(next, pe->hold_until_us);
			}
			if (pe->used && !pe->phantom) {
				next = MIN(next, pe->last_valid_us + params.loss_ms * 1000LL + 1);
			}
		}
	}
	return next == INT64_MAX ? UINT32_MAX : (uint32_t)CLAMP(next - now, 0, 1000000);
}

static void bridge_active(uint8_t pipe)
{
	if (pipe && (pipe >= NUM_PIPES || !peers[pipe].used)) {
		rec_text("error active: pipe %u not linked", pipe);
		return;
	}
	if (active_pipe) {
		rec_link(LINK_INACTIVE, active_pipe, peers[active_pipe].addr);
	}
	active_pipe = pipe;
	br.last_active_tx_us = 0; /* tell it at once: refresh is due */
	if (pipe) {
		rec_link(LINK_ACTIVE, pipe, peers[pipe].addr);
	}
	rec_text("ok active %u", pipe);
}

static void bridge_phantom(uint8_t n)
{
	for (uint8_t p = NUM_PIPES - 1; p >= 1 && n; p--) {
		struct peer *pe = &peers[p];

		if (!pe->used && !pe->hold_until_us) {
			memset(pe, 0, sizeof(*pe));
			pe->used = pe->phantom = pe->established = true;
			sys_rand_get(pe->sk.bytes, sizeof(pe->sk.bytes));
			rec_link(LINK_ESTABLISHED, p, pe->addr);
			n--;
		}
	}
	rec_text("ok phantom%s", n ? " (no free pipe)" : "");
}

/* Receiver ----------------------------------------------------------- */

enum { UNLINKED, PENDING, LINKED };

static struct {
	uint8_t st;
	bool busy, active;
	uint32_t hello_id;
	uint8_t hello_len;
	int64_t next_hello_us, pending_until_us, last_valid_us;
} rx;

static void rx_unlink(bool lost)
{
	if (lost) {
		rec_link(LINK_LOST, self.pipe, NULL);
	}
	link_key_destroy(&self.sk);
	rx.st = UNLINKED;
	rx.busy = false;
	rx.active = false;
	rx.next_hello_us = 0;
	radio_mode(RADIO_PTX, BIT(0));
}

static void rx_load_status(void)
{
	uint8_t out[RADIO_MAX_PAYLOAD], data[2] = {1 /* USB configured */, 0};
	int n = session_seal(&self.sk, &self.tx_counter, LINK_DIR_TO_BRIDGE, PKT_STATUS,
			     rx.active ? PKT_FLAG_ACTIVE : 0, pkt_new_id(), data, 2, out);

	(void)radio_ack_payload(self.pipe, out, n);
}

static void receiver_event(const struct radio_evt *e)
{
	struct radio_evt ack;
	struct pkt_body b;

	if (rx.st == UNLINKED) {
		if ((e->type != RADIO_EVT_TX_OK && e->type != RADIO_EVT_TX_FAIL) || !rx.busy) {
			return;
		}
		bool ok = e->type == RADIO_EVT_TX_OK;
		bool has_ack = ok && radio_take_ack(0, &ack);

		rec_txdone(e, rx.hello_id, 0, PKT_HELLO, ok, rx.hello_len, has_ack ? ack.len : 0);
		rx.busy = false;
		if (has_ack && disco_receiver_welcome(&ack) > 0) {
			rx.st = PENDING;
			rx.pending_until_us = radio_now_us() + 2 * params.hold_ms * 1000LL;
			radio_mode(RADIO_PRX, BIT(self.pipe));
			rx_load_status();
			radio_listen();
		}
		return;
	}
	if (e->type != RADIO_EVT_RX || e->pipe != self.pipe) {
		return;
	}
	int n = link_open(&self.sk, LINK_DIR_TO_RECEIVER, &self.rp, e->data, e->len, (uint8_t *)&b);

	if (n == -EALREADY) {
		atomic_inc(&counters.replay_reject);
		return;
	}
	if (n < 0) {
		atomic_inc(&counters.mic_fail);
		return;
	}
	rec_rxpkt(e, stamp_now(), b.id, b.kind);
	rx.last_valid_us = radio_now_us();
	if (rx.st == PENDING) {
		rx.st = LINKED;
		rec_link(LINK_ESTABLISHED, self.pipe, NULL);
	}
	bool act = b.flags & PKT_FLAG_ACTIVE;

	if (act != rx.active) {
		rx.active = act;
		rec_link(act ? LINK_ACTIVE : LINK_INACTIVE, self.pipe, NULL);
	}
	rx_load_status();
}

static uint32_t receiver_tick(void)
{
	int64_t now = radio_now_us();
	uint8_t out[RADIO_MAX_PAYLOAD];

	switch (rx.st) {
	case UNLINKED:
		if (!rx.busy && now >= rx.next_hello_us) {
			rx.hello_len = disco_receiver_hello(out);
			rx.hello_id = pkt_new_id();
			if (radio_send(0, out, rx.hello_len, params.retries_hello) == 0) {
				rx.busy = true;
			}
			rx.next_hello_us = now + (params.hello_ms +
						  sys_rand32_get() % (params.hello_jitter_ms + 1)) *
							 1000LL;
		}
		return rx.busy ? BUSY_WAIT_US : (uint32_t)MAX(rx.next_hello_us - now, 0);
	case PENDING:
		if (now >= rx.pending_until_us) {
			rx_unlink(false);
			return 0;
		}
		return rx.pending_until_us - now;
	default:
		if (now - rx.last_valid_us > params.loss_ms * 1000LL) {
			rx_unlink(true);
			return 0;
		}
		return rx.last_valid_us + params.loss_ms * 1000LL + 1 - now;
	}
}

/* Both sides ----------------------------------------------------------- */

static void start(void)
{
	memset(&br, 0, sizeof(br));
	memset(&rx, 0, sizeof(rx));
	if (g_role == 1) {
		bridge_listen();
	} else {
		rx_unlink(false);
	}
}

static void stop(void)
{
	radio_mode(RADIO_OFF, 0);
}

static void event(const struct radio_evt *e)
{
	if (g_role == 1) {
		bridge_event(e);
	} else {
		receiver_event(e);
	}
}

static uint32_t tick(void)
{
	return g_role == 1 ? bridge_tick() : receiver_tick();
}

const struct cand cand_b = {
	.start = start, .stop = stop, .event = event, .tick = tick,
	.active = bridge_active, .phantom = bridge_phantom,
};
```

## src/cmd.c
```c
#include "cmd.h"

#include <stdlib.h>
#include <string.h>
#include <zephyr/kernel.h>
#include <zephyr/linker/section_tags.h>
#include <zephyr/sys/atomic.h>

#include "fw_version.h"
#include "ident.h"
#include "link.h"
#include "radio.h"
#include "traffic.h"
#include "rec.h"
#include "stamp.h"
#include "wdt.h"

#define MAX_ARGS 8

uint8_t g_role;
uint8_t g_cand;
static uint32_t boot_id;
static atomic_t stop_feeding;

/* `kmb reboot` keeps the role and settings across the watchdog reset, so
 * discovery (T7) runs from boot without waiting for the host. RAM survives
 * a watchdog reset; Zephyr doesn't clear .noinit. */
#define KEEP_MAGIC 0x4B4D5352
static __noinit struct {
	uint32_t magic;
	uint8_t role, cand;
	struct bench_params params;
} keep;

void cmd_resume(void)
{
	if (keep.magic != KEEP_MAGIC) {
		return;
	}
	keep.magic = 0;
	params = keep.params;
	if (keep.role) {
		radio_command(CMD_ROLE, keep.role, keep.cand);
	}
}

void cmd_init(uint32_t id)
{
	boot_id = id;
}

bool cmd_feed_watchdog(void)
{
	return !atomic_get(&stop_feeding);
}

void cmd_boot_record(void)
{
	struct rec_boot b = {
		.type = REC_BOOT,
		.t = stamp_now(),
		.boot_id = boot_id,
		.role = g_role,
		.cand = g_cand,
	};
	char sn[13];

	ident_serial(sn);
	memcpy(b.serial, sn, sizeof(b.serial));
	memcpy(b.fw, FW_VERSION, MIN(strlen(FW_VERSION), sizeof(b.fw)));
	rec_put(&b, sizeof(b));
}

static void cmd_flood(int argc, char **argv)
{
	unsigned long n = argc > 1 ? strtoul(argv[1], NULL, 10) : 0;

	for (unsigned long i = 0; i < n; i++) {
		rec_stats();
		if (i % 1000 == 0 && cmd_feed_watchdog()) {
			wdt_feed(); /* a long flood outlasts the 2 s watchdog */
		}
	}
	rec_text("ok flood %lu", n);
}

static const struct {
	const char *name;
	void *p;
	uint8_t size;
} settable[] = {
	{"ch", &params.channel, 1},
	{"power", &params.tx_power, 1},
	{"ard", &params.ard_us, 2},
	{"retries_report", &params.retries_report, 1},
	{"retries_poll", &params.retries_poll, 1},
	{"retries_ping", &params.retries_ping, 1},
	{"retries_hello", &params.retries_hello, 1},
	{"ping_ms", &params.ping_ms, 2},
	{"refresh_ms", &params.refresh_ms, 2},
	{"hello_ms", &params.hello_ms, 2},
	{"hello_jitter_ms", &params.hello_jitter_ms, 2},
	{"poll_active_us", &params.poll_active_us, 2},
	{"poll_idle_ms", &params.poll_idle_ms, 2},
	{"loss_ms", &params.loss_ms, 2},
	{"hold_ms", &params.hold_ms, 2},
	{"fast_ramp", &params.fast_ramp, 1},
};

/* Takes effect at the next `kmb role`. */
static void cmd_set(int argc, char **argv)
{
	if (argc == 2 && !strcmp(argv[1], "defaults")) {
		params = params_default; /* settings outlive roles: runs reset them */
		rec_text("ok set defaults");
		return;
	}
	if (argc < 3) {
		rec_text("error set: name value");
		return;
	}
	long v = strtol(argv[2], NULL, 0);

	for (size_t i = 0; i < ARRAY_SIZE(settable); i++) {
		if (!strcmp(argv[1], settable[i].name)) {
			if (settable[i].size == 1) {
				*(uint8_t *)settable[i].p = (uint8_t)v;
			} else {
				*(uint16_t *)settable[i].p = (uint16_t)v;
			}
			rec_text("ok set %s %ld", argv[1], v);
			return;
		}
	}
	rec_text("error set: unknown %s", argv[1]);
}

static void cmd_role(int argc, char **argv)
{
	uint8_t role = argc > 1 && !strcmp(argv[1], "bridge")     ? 1
		       : argc > 1 && !strcmp(argv[1], "receiver") ? 2
								  : 0;
	uint8_t cand = argc > 2 ? argv[2][0] : 0;

	if (role && cand != 'A' && cand != 'B') {
		rec_text("error role: bridge|receiver|none A|B");
		return;
	}
	radio_command(CMD_ROLE, role, cand);
}

static void cmd_traffic(int argc, char **argv)
{
	uint32_t v[4] = {0};
	int err = -EINVAL;

	for (int i = 2; i < argc && i < 6; i++) {
		v[i - 2] = strtoul(argv[i], NULL, 10);
	}
	if (argc < 2) {
		;
	} else if (!strcmp(argv[1], "stop")) {
		traffic_stop();
		err = 0;
	} else if (!strcmp(argv[1], "single") && argc >= 5) {
		err = traffic_start(PAT_SINGLE, v[0], v[1], v[2], 0);
	} else if (!strcmp(argv[1], "burst") && argc >= 6) {
		err = traffic_start(PAT_BURST, v[0], v[1], v[2], v[3]);
	} else if (!strcmp(argv[1], "stream") && argc >= 4) {
		err = traffic_start(PAT_STREAM, v[0], v[1], 0, 0);
	}
	if (err) {
		rec_text("error traffic %d", err);
	} else {
		rec_text("ok traffic %s", argv[1]);
	}
}

void cmd_handle(char *line)
{
	char *argv[MAX_ARGS];
	int argc = 0;
	char *p = strstr(line, "kmb ");

	if (p == NULL) {
		return;
	}
	for (char *tok = strtok(p + 4, " \t"); tok && argc < MAX_ARGS;
	     tok = strtok(NULL, " \t")) {
		argv[argc++] = tok;
	}
	if (argc == 0) {
		return;
	}

	if (!strcmp(argv[0], "info")) {
		cmd_boot_record();
	} else if (!strcmp(argv[0], "stats")) {
		rec_stats();
	} else if (!strcmp(argv[0], "dfu")) {
		rec_text("ok dfu");
		k_msleep(100); /* let the reply reach the host */
		ident_reboot_to_bootloader();
	} else if (!strcmp(argv[0], "reboot")) {
		/* Through the watchdog: a soft reset would leave it running. */
		keep.role = g_role;
		keep.cand = g_cand;
		keep.params = params;
		keep.magic = KEEP_MAGIC;
		rec_text("ok reboot");
		atomic_set(&stop_feeding, 1);
	} else if (!strcmp(argv[0], "hang")) {
		rec_text("ok hang");
		for (;;) {
			k_sleep(K_FOREVER);
		}
	} else if (!strcmp(argv[0], "role")) {
		cmd_role(argc, argv);
	} else if (!strcmp(argv[0], "active")) {
		radio_command(CMD_ACTIVE,
			      argc > 1 && strcmp(argv[1], "none") ? strtoul(argv[1], NULL, 10) : 0, 0);
	} else if (!strcmp(argv[0], "phantom")) {
		radio_command(CMD_PHANTOM, argc > 1 ? strtoul(argv[1], NULL, 10) : 1, 0);
	} else if (!strcmp(argv[0], "jam")) {
		bool off = argc < 2 || !strcmp(argv[1], "off");
		long ch = off ? 0 : strtol(argv[1], NULL, 0);
		long pct = off || argc < 3 ? 0 : strtol(argv[2], NULL, 0);

		if (!off && (ch < 0 || ch > 80 || pct < 1 || pct > 75)) {
			rec_text("error jam: <ch 0..80> <percent 1..75> | off");
		} else {
			radio_command(CMD_JAM, (uint8_t)ch, (uint8_t)pct);
		}
	} else if (!strcmp(argv[0], "scan")) {
		unsigned long dwell = argc > 1 ? strtoul(argv[1], NULL, 10) : 200;

		radio_command(CMD_SCAN, dwell & 0xff, (dwell >> 8) & 0xff);
	} else if (!strcmp(argv[0], "set")) {
		cmd_set(argc, argv);
	} else if (!strcmp(argv[0], "traffic")) {
		cmd_traffic(argc, argv);
	} else if (!strcmp(argv[0], "selftest")) {
		link_selftest();
	} else if (!strcmp(argv[0], "flood")) {
		cmd_flood(argc, argv);
	} else {
		rec_text("error unknown command %s", argv[0]);
	}
}
```

## src/cmd.h
```c
/* `kmb` commands from the host. */
#pragma once
#include <stdbool.h>
#include <stdint.h>

extern uint8_t g_role; /* 0 none, 1 bridge, 2 receiver */
extern uint8_t g_cand; /* 0, 'A' or 'B' */

void cmd_init(uint32_t boot_id);
/* Handle one line; anything before "kmb " is ignored, lines without it too. */
void cmd_handle(char *line);
void cmd_boot_record(void);
/* After `kmb reboot`: restore settings and start the role again. */
void cmd_resume(void);
/* False once `kmb reboot` asked the watchdog to reset the dongle. */
bool cmd_feed_watchdog(void);
```

## src/ident.c
```c
#include "ident.h"

#include <hal/nrf_gpio.h>
#include <nrfx.h>
#include <zephyr/device.h>
#include <zephyr/kernel.h>
#include <zephyr/sys/printk.h>

#define KMS_VID 0x1209
#define KMS_PID 0x0001
#define RESET_PIN 19

USBD_DEVICE_DEFINE(kms_usbd, DEVICE_DT_GET(DT_NODELABEL(zephyr_udc0)), KMS_VID, KMS_PID);
USBD_DESC_LANG_DEFINE(kms_lang);
USBD_DESC_MANUFACTURER_DEFINE(kms_mfr, "KMSwitch");
USBD_DESC_PRODUCT_DEFINE(kms_product, "KMS radio bench");
USBD_DESC_CONFIG_DEFINE(kms_fs_cfg_desc, "FS Configuration");
USBD_CONFIGURATION_DEFINE(kms_fs_config, 0, 50 /* x 2 mA */, &kms_fs_cfg_desc);

/* Filled from FICR before the stack starts; read on every host request. */
static uint8_t sn_ascii[13];
static struct usbd_desc_node kms_sn = {
	.str = {
		.utype = USBD_DUT_STRING_SERIAL_NUMBER,
		.ascii7 = true,
	},
	.ptr = sn_ascii,
	.bLength = USB_STRING_DESCRIPTOR_LENGTH("000000000000"),
	.bDescriptorType = USB_DESC_STRING,
};

void ident_serial(char out[13])
{
	uint16_t hi = (uint16_t)NRF_FICR->DEVICEADDR[1] | 0xC000;
	uint32_t lo = NRF_FICR->DEVICEADDR[0];

	snprintk(out, 13, "%04X%08X", hi, lo);
}

int ident_usb_init(usbd_msg_cb_t cb)
{
	int err;

	ident_serial((char *)sn_ascii);
	err = usbd_add_descriptor(&kms_usbd, &kms_lang);
	err = err ?: usbd_add_descriptor(&kms_usbd, &kms_mfr);
	err = err ?: usbd_add_descriptor(&kms_usbd, &kms_product);
	err = err ?: usbd_add_descriptor(&kms_usbd, &kms_sn);
	err = err ?: usbd_add_configuration(&kms_usbd, USBD_SPEED_FS, &kms_fs_config);
	err = err ?: usbd_register_all_classes(&kms_usbd, USBD_SPEED_FS, 1, NULL);
	/* CDC ACM uses an interface association. */
	err = err ?: usbd_device_set_code_triple(&kms_usbd, USBD_SPEED_FS,
						 USB_BCC_MISCELLANEOUS, 0x02, 0x01);
	err = err ?: usbd_msg_register_cb(&kms_usbd, cb);
	err = err ?: usbd_init(&kms_usbd);
	if (!err && !usbd_can_detect_vbus(&kms_usbd)) {
		err = usbd_enable(&kms_usbd);
	}
	return err;
}

FUNC_NORETURN void ident_reboot_to_bootloader(void)
{
	(void)irq_lock();
	nrf_gpio_cfg_output(RESET_PIN);
	nrf_gpio_pin_clear(RESET_PIN);
	for (;;) {
	}
}
```

## src/ident.h
```c
/* Identity, USB device setup and the reboot into the bootloader. */
#pragma once
#include <zephyr/usb/usbd.h>

/* The bootloader's serial: "%04X%08X" of DEVICEADDR[1] | 0xC000 and
 * DEVICEADDR[0] (nRF5 SDK app_usbd_serial_num.c). */
void ident_serial(char out[13]);
int ident_usb_init(usbd_msg_cb_t cb);
/* Drive P0.19 low: on the PCA10059 it is wired to RESET, and the Open DFU
 * bootloader enters DFU after a pin reset. Does not return. */
FUNC_NORETURN void ident_reboot_to_bootloader(void);
```

## src/jam.c
```c
/*
 * `kmb jam <ch> <percent>`: a controlled interferer for the bench. Sends
 * 25-byte dummy packets on channel <ch> with exponentially distributed
 * gaps, so about <percent> % of the time is on air and the timing never
 * locks to the link under test. `kmb jam off` stops it and reports the
 * on-air share it reached. Drives RADIO directly with ESB off, like the
 * scan, and runs as a pseudo-candidate in the radio thread.
 */
#include <hal/nrf_radio.h>
#include <math.h>
#include <zephyr/kernel.h>
#include <zephyr/random/random.h>

#include "radio.h"
#include "rec.h"
#include "stamp.h"

#define JAM_LEN 25
/* On air at 2 Mbit/s: preamble 2, address 5, length 1, payload, CRC 2. */
#define AIR_US ((2 + 5 + 1 + JAM_LEN + 2) * 4)

static struct {
	uint8_t ch, percent;
	uint32_t sent, t0;
	uint8_t pkt[1 + JAM_LEN];
} jam;

static void wait_event(nrf_radio_event_t ev)
{
	while (!nrf_radio_event_check(NRF_RADIO, ev)) {
	}
	nrf_radio_event_clear(NRF_RADIO, ev);
}

void jam_set(uint8_t ch, uint8_t percent)
{
	jam.ch = ch;
	jam.percent = percent;
}

static void jam_start(void)
{
	nrf_radio_packet_conf_t conf = {
		.lflen = 8, .plen = NRF_RADIO_PREAMBLE_LENGTH_16BIT, .maxlen = JAM_LEN,
		.balen = 4, .big_endian = true, .whiteen = true,
	};

	radio_mode(RADIO_OFF, 0);
	nrf_radio_mode_set(NRF_RADIO, NRF_RADIO_MODE_NRF_2MBIT);
	nrf_radio_modecnf0_set(NRF_RADIO, params.fast_ramp, RADIO_MODECNF0_DTX_Center);
	nrf_radio_packet_configure(NRF_RADIO, &conf);
	nrf_radio_base0_set(NRF_RADIO, 0x4A414D21); /* "JAM!", no bench address */
	nrf_radio_prefix0_set(NRF_RADIO, 0x5A);
	nrf_radio_txaddress_set(NRF_RADIO, 0);
	nrf_radio_crc_configure(NRF_RADIO, 2, NRF_RADIO_CRC_ADDR_INCLUDE, 0x11021);
	nrf_radio_crcinit_set(NRF_RADIO, 0xFFFF);
	nrf_radio_datawhiteiv_set(NRF_RADIO, jam.ch);
	nrf_radio_txpower_set(NRF_RADIO, (nrf_radio_txpower_t)(uint8_t)params.tx_power);
	nrf_radio_frequency_set(NRF_RADIO, 2400 + jam.ch);
	nrf_radio_shorts_set(NRF_RADIO,
			     NRF_RADIO_SHORT_READY_START_MASK | NRF_RADIO_SHORT_END_DISABLE_MASK);
	jam.pkt[0] = JAM_LEN;
	sys_rand_get(&jam.pkt[1], JAM_LEN);
	nrf_radio_packetptr_set(NRF_RADIO, jam.pkt);
	jam.sent = 0;
	jam.t0 = stamp_now();
}

static void jam_stop(void)
{
	uint32_t dt = stamp_now() - jam.t0;
	uint32_t permille = dt ? (uint32_t)((uint64_t)jam.sent * AIR_US * 1000 / dt) : 0;

	nrf_radio_shorts_set(NRF_RADIO, 0);
	if (nrf_radio_state_get(NRF_RADIO) != NRF_RADIO_STATE_DISABLED) {
		nrf_radio_event_clear(NRF_RADIO, NRF_RADIO_EVENT_DISABLED);
		nrf_radio_task_trigger(NRF_RADIO, NRF_RADIO_TASK_DISABLE);
		wait_event(NRF_RADIO_EVENT_DISABLED);
	}
	rec_text("ok jam off: ch %u, %u packets, %u.%u %% on air", jam.ch, jam.sent,
		 permille / 10, permille % 10);
}

static void jam_event(const struct radio_evt *e)
{
	ARG_UNUSED(e);
}

/* One packet, then an exponential gap whose mean, with the ramp-up, puts
 * `percent` of the time on air. */
static uint32_t jam_tick(void)
{
	float ramp = params.fast_ramp ? 40.0f : 130.0f;
	float mean = AIR_US * 100.0f / jam.percent - AIR_US - ramp;
	float u = ((float)sys_rand32_get() + 1.0f) / 4294967296.0f;

	nrf_radio_event_clear(NRF_RADIO, NRF_RADIO_EVENT_DISABLED);
	nrf_radio_task_trigger(NRF_RADIO, NRF_RADIO_TASK_TXEN);
	wait_event(NRF_RADIO_EVENT_DISABLED);
	jam.sent++;
	return mean > 0.0f ? (uint32_t)(-mean * logf(u)) : 0;
}

const struct cand cand_jam = {
	.start = jam_start, .stop = jam_stop, .event = jam_event, .tick = jam_tick,
};
```

## src/link.c
```c
#include "link.h"

#include <errno.h>
#include <hal/nrf_ecb.h>
#include <string.h>
#include <zephyr/kernel.h>
#include <zephyr/sys/byteorder.h>

#include "rec.h"
#include "stamp.h"

#define NONCE_LEN 13

/* BENCH ONLY: a public constant, never the real key (~/.kmswitch-key). */
static const link_key_t psk = {{'K', 'M', 'S', ' ', 'b', 'e', 'n', 'c', 'h', ' ', 'k', 'e',
				'y', ' ', '0', '1'}};

static struct {
	uint8_t key[16];
	uint8_t clear[16];
	uint8_t cipher[16];
} __aligned(4) ecb;
/* A mutex, not a spinlock: with interrupts off for each block, the
 * ADDRESS-stamp interrupt ran late and lost stamps. Threads only. */
K_MUTEX_DEFINE(ecb_lock);

void link_aes_block(const uint8_t key[16], const uint8_t in[16], uint8_t out[16])
{
	k_mutex_lock(&ecb_lock, K_FOREVER);

	memcpy(ecb.key, key, 16);
	memcpy(ecb.clear, in, 16);
	nrf_ecb_data_pointer_set(NRF_ECB, &ecb);
	nrf_ecb_event_clear(NRF_ECB, NRF_ECB_EVENT_ENDECB);
	nrf_ecb_event_clear(NRF_ECB, NRF_ECB_EVENT_ERRORECB);
	nrf_ecb_task_trigger(NRF_ECB, NRF_ECB_TASK_STARTECB);
	while (!nrf_ecb_event_check(NRF_ECB, NRF_ECB_EVENT_ENDECB) &&
	       !nrf_ecb_event_check(NRF_ECB, NRF_ECB_EVENT_ERRORECB)) {
	}
	memcpy(out, ecb.cipher, 16);
	memset(ecb.key, 0, 16);
	k_mutex_unlock(&ecb_lock);
}

static void xor16(uint8_t *x, const uint8_t *b, size_t n)
{
	for (size_t i = 0; i < n; i++) {
		x[i] ^= b[i];
	}
}

/* RFC 3610. L = 15 - nlen bytes of length/counter; flags in B0 and A_i. */
static void ccm_mac(const uint8_t key[16], const uint8_t *nonce, size_t nlen, const uint8_t *aad,
		    size_t alen, const uint8_t *pt, size_t len, size_t mlen, uint8_t x[16])
{
	size_t L = 15 - nlen;
	uint8_t b[16];

	b[0] = (alen ? 0x40 : 0) | (((mlen - 2) / 2) << 3) | (L - 1);
	memcpy(&b[1], nonce, nlen);
	for (size_t i = 0; i < L; i++) {
		b[15 - i] = (len >> (8 * i)) & 0xff;
	}
	link_aes_block(key, b, x);

	if (alen) {
		/* a < 2^16 - 2^8: two length bytes, then the data, zero-padded. */
		size_t used = 2;

		memset(b, 0, 16);
		b[0] = alen >> 8;
		b[1] = alen & 0xff;
		for (size_t i = 0; i < alen; i++) {
			b[used++] = aad[i];
			if (used == 16) {
				xor16(x, b, 16);
				link_aes_block(key, x, x);
				memset(b, 0, 16);
				used = 0;
			}
		}
		if (used) {
			xor16(x, b, 16);
			link_aes_block(key, x, x);
		}
	}
	for (size_t off = 0; off < len; off += 16) {
		xor16(x, pt + off, MIN(16, len - off));
		link_aes_block(key, x, x);
	}
}

static void ccm_ctr_block(const uint8_t key[16], const uint8_t *nonce, size_t nlen, uint32_t i,
			  uint8_t s[16])
{
	size_t L = 15 - nlen;
	uint8_t a[16] = {0};

	a[0] = L - 1;
	memcpy(&a[1], nonce, nlen);
	for (size_t j = 0; j < L && j < 4; j++) {
		a[15 - j] = (i >> (8 * j)) & 0xff;
	}
	link_aes_block(key, a, s);
}

static void ccm_crypt(const uint8_t key[16], const uint8_t *nonce, size_t nlen,
		      const uint8_t *in, size_t len, uint8_t *out)
{
	uint8_t s[16];

	for (size_t off = 0, i = 1; off < len; off += 16, i++) {
		size_t n = MIN(16, len - off);

		ccm_ctr_block(key, nonce, nlen, i, s);
		for (size_t j = 0; j < n; j++) {
			out[off + j] = in[off + j] ^ s[j];
		}
	}
}

void link_ccm_seal(const uint8_t key[16], const uint8_t *nonce, size_t nlen, const uint8_t *aad,
		   size_t alen, const uint8_t *pt, size_t len, uint8_t *out, size_t mlen)
{
	uint8_t x[16], s0[16];

	ccm_mac(key, nonce, nlen, aad, alen, pt, len, mlen, x);
	ccm_ctr_block(key, nonce, nlen, 0, s0);
	ccm_crypt(key, nonce, nlen, pt, len, out);
	for (size_t j = 0; j < mlen; j++) {
		out[len + j] = x[j] ^ s0[j];
	}
}

bool link_ccm_open(const uint8_t key[16], const uint8_t *nonce, size_t nlen, const uint8_t *aad,
		   size_t alen, const uint8_t *in, size_t len, uint8_t *pt, size_t mlen)
{
	uint8_t x[16], s0[16], diff = 0;
	size_t plen = len - mlen;

	ccm_crypt(key, nonce, nlen, in, plen, pt);
	ccm_mac(key, nonce, nlen, aad, alen, pt, plen, mlen, x);
	ccm_ctr_block(key, nonce, nlen, 0, s0);
	for (size_t j = 0; j < mlen; j++) {
		diff |= (x[j] ^ s0[j]) ^ in[plen + j];
	}
	if (diff) {
		memset(pt, 0, plen);
	}
	return diff == 0;
}

void link_session_key(const uint8_t salt_b[8], const uint8_t salt_r[8], link_key_t *sk)
{
	uint8_t in[16];

	memcpy(in, salt_b, 8);
	memcpy(in + 8, salt_r, 8);
	link_aes_block(psk.bytes, in, sk->bytes);
}

void link_key_destroy(link_key_t *key)
{
	memset(key->bytes, 0, sizeof(key->bytes));
}

static void nonce_session(uint8_t n[NONCE_LEN], uint32_t counter, uint8_t dir)
{
	sys_put_le32(counter, n);
	n[4] = dir;
	memset(&n[5], 0, 8);
}

static void nonce_discovery(uint8_t n[NONCE_LEN], uint8_t dir, const uint8_t salt[8])
{
	memset(n, 0, 4);
	n[4] = dir;
	memcpy(&n[5], salt, 8);
}

int link_seal(const link_key_t *key, uint32_t counter, uint8_t dir, const uint8_t *body,
	      size_t len, uint8_t *out)
{
	uint8_t n[NONCE_LEN];

	nonce_session(n, counter, dir);
	sys_put_le32(counter, out);
	link_ccm_seal(key->bytes, n, NONCE_LEN, NULL, 0, body, len, out + 4, LINK_MIC_LEN);
	return 4 + len + LINK_MIC_LEN;
}

int link_open(const link_key_t *key, uint8_t dir, struct replay *rp, const uint8_t *in, size_t len,
	      uint8_t *body)
{
	uint8_t n[NONCE_LEN];

	if (len < 4 + LINK_MIC_LEN) {
		return -EINVAL;
	}
	uint32_t counter = sys_get_le32(in);

	/* State changes only after the MIC verifies, so a forged counter
	 * can't block the session. */
	if (rp->any && counter <= rp->last) {
		return -EALREADY;
	}
	nonce_session(n, counter, dir);
	if (!link_ccm_open(key->bytes, n, NONCE_LEN, NULL, 0, in + 4, len - 4, body,
			   LINK_MIC_LEN)) {
		return -EBADMSG;
	}
	rp->any = true;
	rp->last = counter;
	return len - 4 - LINK_MIC_LEN;
}

int link_seal_discovery(uint8_t dir, const uint8_t salt[8], const uint8_t *body, size_t len,
			uint8_t *out)
{
	uint8_t n[NONCE_LEN];

	nonce_discovery(n, dir, salt);
	memcpy(out, salt, LINK_SALT_LEN);
	link_ccm_seal(psk.bytes, n, NONCE_LEN, NULL, 0, body, len, out + LINK_SALT_LEN,
		      LINK_MIC_LEN);
	return LINK_SALT_LEN + len + LINK_MIC_LEN;
}

int link_open_discovery(uint8_t dir, const uint8_t *in, size_t len, uint8_t salt[8],
			uint8_t *body)
{
	uint8_t n[NONCE_LEN];

	if (len < LINK_SALT_LEN + LINK_MIC_LEN) {
		return -EINVAL;
	}
	memcpy(salt, in, LINK_SALT_LEN);
	nonce_discovery(n, dir, salt);
	if (!link_ccm_open(psk.bytes, n, NONCE_LEN, NULL, 0, in + LINK_SALT_LEN,
			   len - LINK_SALT_LEN, body, LINK_MIC_LEN)) {
		return -EBADMSG;
	}
	return len - LINK_SALT_LEN - LINK_MIC_LEN;
}

/* Self-test constants, computed independently by
 * bench/radio-spike/host/tests/test_vectors.py. */
static const uint8_t nist_key[16] = {0x40, 0x41, 0x42, 0x43, 0x44, 0x45, 0x46, 0x47,
				     0x48, 0x49, 0x4a, 0x4b, 0x4c, 0x4d, 0x4e, 0x4f};
static const uint8_t nist1_ct[8] = {0x71, 0x62, 0x01, 0x5b, 0x4d, 0xac, 0x25, 0x5d};
static const uint8_t nist2_ct[22] = {0xd2, 0xa1, 0xf0, 0xe0, 0x51, 0xea, 0x5f, 0x62,
				     0x08, 0x1a, 0x77, 0x92, 0x07, 0x3d, 0x59, 0x3d,
				     0x1f, 0xc6, 0x4f, 0xbf, 0xac, 0xcd};
static const uint8_t salt_b[8] = {0x10, 0x11, 0x12, 0x13, 0x14, 0x15, 0x16, 0x17};
static const uint8_t salt_r[8] = {0x20, 0x21, 0x22, 0x23, 0x24, 0x25, 0x26, 0x27};
static const uint8_t sk_expected[16] = {0xb4, 0x83, 0x52, 0x9c, 0xc3, 0x1c, 0x16, 0xb5,
					0x98, 0xdf, 0x0b, 0x30, 0x13, 0x5f, 0x30, 0x83};
static const uint8_t layout_sealed[4 + 21] = {
	0x05, 0x00, 0x00, 0x00, /* counter 5 in the clear */
	0x55, 0x64, 0xa6, 0x20, 0x93, 0xc9, 0x65, 0xa7, 0xaa, 0x7f, 0x9a,
	0xac, 0x0f, 0xde, 0x39, 0xe6, 0xbf, 0x0f, 0xf0, 0x53, 0xfb};

static void seq(uint8_t *p, size_t n, uint8_t first)
{
	for (size_t i = 0; i < n; i++) {
		p[i] = first + i;
	}
}

/* SP 800-38C examples 1 (partial blocks, 4-byte MIC) and 2 (full
 * blocks, 6-byte MIC), both ways. */
static bool check_nist(void)
{
	uint8_t nonce[8], aad[16], pt[16], out[22], back[16];

	seq(nonce, 7, 0x10);
	seq(aad, 8, 0x00);
	seq(pt, 4, 0x20);
	link_ccm_seal(nist_key, nonce, 7, aad, 8, pt, 4, out, 4);
	bool ok = memcmp(out, nist1_ct, 8) == 0 &&
		  link_ccm_open(nist_key, nonce, 7, aad, 8, out, 8, back, 4) &&
		  memcmp(back, pt, 4) == 0;

	seq(nonce, 8, 0x10);
	seq(aad, 16, 0x00);
	seq(pt, 16, 0x20);
	link_ccm_seal(nist_key, nonce, 8, aad, 16, pt, 16, out, 6);
	return ok && memcmp(out, nist2_ct, 22) == 0 &&
	       link_ccm_open(nist_key, nonce, 8, aad, 16, out, 22, back, 6) &&
	       memcmp(back, pt, 16) == 0;
}

void link_selftest(void)
{
	struct rec_selftest r = {.type = REC_SELFTEST};
	uint8_t pt[17], out[4 + 21], back[17];
	link_key_t sk;
	struct replay rp = {0}, fresh = {0}, timing = {0};
	uint32_t t0;
	const int rounds = 20;

	seq(pt, 17, 0x30);
	r.nist_ok = check_nist();

	link_session_key(salt_b, salt_r, &sk);
	r.layout_ok = memcmp(sk.bytes, sk_expected, 16) == 0 &&
		      link_seal(&sk, 5, LINK_DIR_TO_BRIDGE, pt, 17, out) == sizeof(out) &&
		      memcmp(out, layout_sealed, sizeof(out)) == 0;

	/* A fresh session accepts counter 0 once, then rejects it. */
	link_seal(&sk, 0, LINK_DIR_TO_BRIDGE, pt, 17, out);
	r.replay_ok = link_open(&sk, LINK_DIR_TO_BRIDGE, &rp, out, sizeof(out), back) == 17 &&
		      memcmp(back, pt, 17) == 0 &&
		      link_open(&sk, LINK_DIR_TO_BRIDGE, &rp, out, sizeof(out), back) == -EALREADY;

	out[4 + 3] ^= 0x01; /* flip a ciphertext bit */
	r.tamper_ok = link_open(&sk, LINK_DIR_TO_BRIDGE, &fresh, out, sizeof(out), back) == -EBADMSG;

	t0 = stamp_now();
	for (int i = 0; i < rounds; i++) {
		link_seal(&sk, 100 + i, LINK_DIR_TO_RECEIVER, pt, 17, out);
	}
	r.enc_us = (stamp_now() - t0) / rounds;

	t0 = stamp_now();
	for (int i = 0; i < rounds; i++) {
		/* Sealed fresh each time: a repeated counter would stop at the
		 * replay check without decrypting. */
		link_seal(&sk, 1000 + i, LINK_DIR_TO_RECEIVER, pt, 17, out);
		link_open(&sk, LINK_DIR_TO_RECEIVER, &timing, out, sizeof(out), back);
	}
	r.dec_us = (stamp_now() - t0) / rounds - r.enc_us;

	t0 = stamp_now();
	for (int i = 0; i < rounds; i++) {
		link_session_key(salt_b, salt_r, &sk);
	}
	r.sk_us = (stamp_now() - t0) / rounds;
	link_key_destroy(&sk);
	rec_put(&r, sizeof(r));
}
```

## src/link.h
```c
/* Link encryption: AES-128-CCM (RFC 3610) with a 4-byte MIC, in software
 * on the nRF52840's ECB peripheral (one AES block in a few µs).
 *
 * PSA Crypto was measured at about 250 µs per seal or open of a 17-byte
 * body, on the CC310 and on Oberon alike (fixed per-call cost, about 90 µs
 * per AES block), so the bench uses the spec's "ECB peripheral with
 * software CCM" option. Threads only (a mutex guards the ECB). */
#pragma once
#include <stdbool.h>
#include <stddef.h>
#include <stdint.h>

#define LINK_DIR_TO_RECEIVER 0
#define LINK_DIR_TO_BRIDGE 1
#define LINK_MIC_LEN 4
#define LINK_SALT_LEN 8

typedef struct {
	uint8_t bytes[16];
} link_key_t;

/* Replay state of one direction of one session. Zeroed at session start:
 * no counter accepted yet, so counter 0 is accepted once. */
struct replay {
	bool any;
	uint32_t last;
};

/* One AES-128 block on the ECB peripheral. */
void link_aes_block(const uint8_t key[16], const uint8_t in[16], uint8_t out[16]);
/* AES-CCM, any nonce length 7..13 and MIC length 4..16: out = C ‖ MIC. */
void link_ccm_seal(const uint8_t key[16], const uint8_t *nonce, size_t nlen,
		   const uint8_t *aad, size_t alen, const uint8_t *pt, size_t len,
		   uint8_t *out, size_t mlen);
/* Returns true and writes the plaintext if the MIC verifies. */
bool link_ccm_open(const uint8_t key[16], const uint8_t *nonce, size_t nlen,
		   const uint8_t *aad, size_t alen, const uint8_t *in, size_t len,
		   uint8_t *pt, size_t mlen);

/* SK = AES-128-ECB(PSK, salt_b ‖ salt_r). */
void link_session_key(const uint8_t salt_b[8], const uint8_t salt_r[8], link_key_t *sk);
void link_key_destroy(link_key_t *key);
/* out = counter (LE) ‖ ciphertext ‖ MIC; returns len + 8. */
int link_seal(const link_key_t *key, uint32_t counter, uint8_t dir, const uint8_t *body,
	      size_t len, uint8_t *out);
/* Returns the body length, -EBADMSG (MIC), -EALREADY (replay), -EINVAL. */
int link_open(const link_key_t *key, uint8_t dir, struct replay *rp, const uint8_t *in,
	      size_t len, uint8_t *body);
/* Discovery, under the pre-shared key: out = salt ‖ ciphertext ‖ MIC. */
int link_seal_discovery(uint8_t dir, const uint8_t salt[8], const uint8_t *body,
			size_t len, uint8_t *out);
int link_open_discovery(uint8_t dir, const uint8_t *in, size_t len, uint8_t salt[8],
			uint8_t *body);
/* `kmb selftest`: writes a SELFTEST record. */
void link_selftest(void);
```
